## dts/bindings/microchip,mcp3221.yaml
```yaml
description: Microchip MCP3221

compatible: "microchip,mcp3221"

include: [adc-controller.yaml, i2c-device.yaml]

properties:
  "#io-channel-cells":
    const: 1

io-channel-cells:
  - input
```
